## drivers/input/touchscreen/ft5336/Kconfig
```kconfig
#
# FT5336 Touchscreen driver
#

menuconfig ZTEMT_TOUCHSCREEN_FT5336
	bool "ZTEMT_TOUCHSCREEN_FT5336"
	help
	  Say Y here, and a list of supported touchscreens will be displayed.
	  This option doesn't affect the kernel.

	  If unsure, say Y.

if ZTEMT_TOUCHSCREEN_FT5336

config FT5336_TOUCHSCREEN_DRIVER
	tristate "FT5336 touchpanel driver"
	depends on ZTEMT_TOUCHSCREEN_FT5336
	default n
	help
	  This is the main file for touchpanel driver for FT5336
	  touchscreens.

	  Say Y here if you have a FT5336 touchscreen connected
	  to your system.

	  If unsure, say N.

	  To compile this driver as a module, choose M here.

endif
```

## drivers/input/touchscreen/gt1x/Kconfig
```kconfig
#
# Goodix GT1X Touchscreen driver
#

menuconfig ZTEMT_TOUCHSCREEN_GT1X
	bool "ZTEMT_TOUCHSCREEN_GT1X"
	help
	  Say Y here, and a list of supported touchscreens will be displayed.
	  This option doesn't affect the kernel.

	  If unsure, say Y.

if ZTEMT_TOUCHSCREEN_GT1X

config ZTEMT_GT1X_TOUCHSCREEN_DRIVER
	tristate "Goodix GT1X touchpanel driver"
	depends on ZTEMT_TOUCHSCREEN_GT1X
	default n
	help
	  This is the main file for touchpanel driver for Goodix GT1X
	  touchscreens.

	  Say Y here if you have a Goodix GT1X touchscreen connected
	  to your system.

	  If unsure, say N.

choice
	prompt "ztemt gt1x touchscreen sensor id"

config ZTEMT_GT1X_TOUCHSCREEN_SENSOR_1
	bool "ztemt gt1x touchscreen sensor 1 (TPK)"
	help
	  This option enables support gt1x touchscreen sensor 1 TP (TPK).

config ZTEMT_GT1X_TOUCHSCREEN_SENSOR_2
	bool "ztemt gt1x touchscreen sensor 2 (GW)"
	help
	  This option enables support gt1x touchscreen sensor 2 TP (GW).
endchoice

endif
```

## drivers/input/touchscreen/melfas_mms400/Kconfig
```kconfig
#
# Kconfig for MELFAS MMS400 Touchscreen driver
#

menuconfig ZTEMT_TOUCHSCREEN_MELFAS
	bool "ZTEMT_TOUCHSCREEN_MELFAS"
	help
	  Say Y here, and a list of supported touchscreens will be displayed.
	  This option doesn't affect the kernel.

	  If unsure, say N.

if ZTEMT_TOUCHSCREEN_MELFAS

config TOUCHSCREEN_MELFAS_MMS438
        tristate "MELFAS MMS438 Touchscreen"
        depends on I2C
        help
          Say Y here if you have a MELFAS MMS438 touchscreen device in your system.

          If unsure, say N.

          To compile this driver as a module, choose M here: the module will be called mms_ts.

config TOUCHSCREEN_MELFAS_MMS449
        tristate "MELFAS MMS449 Touchscreen"
        depends on I2C
        help
          Say Y here if you have a MELFAS MMS449 touchscreen device in your system.

          If unsure, say N.

          To compile this driver as a module, choose M here: the module will be called mms_ts.

config TOUCHSCREEN_MELFAS_MMS458
        tristate "MELFAS MMS458 Touchscreen"
        depends on I2C
        help
          Say Y here if you have a MELFAS MMS458 touchscreen device in your system.

          If unsure, say N.

          To compile this driver as a module, choose M here: the module will be called mms_ts.

config TOUCHSCREEN_MELFAS_MMS492
        tristate "MELFAS MMS492 Touchscreen"
        depends on I2C
        help
          Say Y here if you have a MELFAS MMS492 touchscreen device in your system.

          If unsure, say N.

          To compile this driver as a module, choose M here: the module will be called mms_ts.

endif
```
