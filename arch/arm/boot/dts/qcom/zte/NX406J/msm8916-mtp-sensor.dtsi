/* Copyright (c) 2014, The Linux Foundation. All rights reserved.
 *
 * This program is free software; you can redistribute it and/or modify
 * it under the terms of the GNU General Public License version 2 and
 * only version 2 as published by the Free Software Foundation.
 *
 * This program is distributed in the hope that it will be useful,
 * but WITHOUT ANY WARRANTY; without even the implied warranty of
 * MERCHANTABILITY or FITNESS FOR A PARTICULAR PURPOSE.  See the
 * GNU General Public License for more details.
 */

&soc {
	i2c@78b6000 { /* BLSP1 QUP2 */
		lsm6ds0@0x6A {
		    compatible = "st,lsm6ds0";
			reg = <0x6A>;
			rot-matrix = /bits/ 16 <(0) (-1) (0)
			    (-1) (0) (0)
				(0) (0) (-1)>;
			g-poll-interval = <100000>;
			g-min-interval = <10000>;
			g-fs-range = <24>;
			x-poll-interval = <100000>;
			x-min-interval = <10000>;
			x-fs-range = <16>;
			aa-filter-bw = <0>;
	    };
	    akm@c {
			compatible = "ak,ak09911";
			reg = <0x0c>;
			pinctrl-names = "default","sleep";
			pinctrl-0 = <&ak09911_default>;
			pinctrl-1 = <&ak09911_sleep>;
			vdd-supply = <&pm8916_l17>;
			vio-supply = <&pm8916_l6>;
			akm,layout = <0x4>;
			akm,gpio_rstn = <&msm_gpio 69 0x0>;
			/*akm,auto-report;*/
		};
	};
};
