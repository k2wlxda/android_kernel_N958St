/* Copyright (c) 2013, The Linux Foundation. All rights reserved.
 *
 * This program is free software; you can redistribute it and/or modify
 * it under the terms of the GNU General Public License version 2 and
 * only version 2 as published by the Free Software Foundation.
 *
 * This program is distributed in the hope that it will be useful,
 * but WITHOUT ANY WARRANTY; without even the implied warranty of
 * MERCHANTABILITY or FITNESS FOR A PARTICULAR PURPOSE.  See the
 * GNU General Public License for more details.
 */

/*---------------------------------------------------------------------------
 * This file is autogenerated file using gcdb parser. Please do not edit it.
 * Update input XML file to add a new entry or update variable in this file
 * VERSION = "1.0"
 *---------------------------------------------------------------------------*/
&mdss_mdp {
	dsi_cs_nt35592_720_vid: qcom,mdss_dsi_cs_nt35592_720p_video {
		qcom,mdss-dsi-panel-name = "cs nt35592 720p video mode dsi panel";
		qcom,mdss-dsi-panel-controller = <&mdss_dsi0>;
		qcom,mdss-dsi-panel-type = "dsi_video_mode";
		qcom,mdss-dsi-panel-destination = "display_1";
		qcom,mdss-dsi-panel-framerate = <60>;
		qcom,mdss-dsi-virtual-channel-id = <0>;
		qcom,mdss-dsi-stream = <0>;
		qcom,mdss-dsi-panel-width = <720>;
		qcom,mdss-dsi-panel-height = <1280>;
		qcom,mdss-dsi-h-front-porch = <12>;
		qcom,mdss-dsi-h-back-porch = <12>;
		qcom,mdss-dsi-h-pulse-width = <4>;
		qcom,mdss-dsi-h-sync-skew = <0>;
		qcom,mdss-dsi-v-back-porch = <2>;
		qcom,mdss-dsi-v-front-porch = <6>;
		qcom,mdss-dsi-v-pulse-width = <2>;
		qcom,mdss-dsi-h-left-border = <0>;
		qcom,mdss-dsi-h-right-border = <0>;
		qcom,mdss-dsi-v-top-border = <0>;
		qcom,mdss-dsi-v-bottom-border = <0>;
		qcom,mdss-dsi-bpp = <24>;
		qcom,mdss-dsi-color-order = <0>;
		qcom,mdss-dsi-underflow-color = <0xff>;
		qcom,mdss-dsi-border-color = <0>;
		//+++duguowei
		//qcom,mdss-dsi-lane-map = "lane_map_2103";//6<2 1 0 3>
		//---duguowei
		qcom,mdss-dsi-on-command = [
            //CMD2 Page0 -Power 
            15 01 00 00 00 00 02 FF 01
            15 01 00 00 00 00 02 FB 01
            15 01 00 00 00 00 02 00 2A
            15 01 00 00 00 00 02 01 33
            15 01 00 00 00 00 02 02 53
            15 01 00 00 00 00 02 03 55
            15 01 00 00 00 00 02 04 55
            15 01 00 00 00 00 02 05 00
            15 01 00 00 00 00 02 06 44
            15 01 00 00 00 00 02 08 26
            15 01 00 00 00 00 02 09 09
            //// GVDDP  GVDDN 
            15 01 00 00 00 00 02 0B CA
            15 01 00 00 00 00 02 0C CA
            15 01 00 00 00 00 02 0D 24
            15 01 00 00 00 00 02 0E 2B
            //VGLO = -6.2V  
            15 01 00 00 00 00 02 0F 96
            15 01 00 00 00 00 02 10 0F
            //VCOMDC 
            15 01 00 00 00 00 02 11 72
            15 01 00 00 00 00 02 12 03
            //power mode 
            15 01 00 00 00 00 02 14 01
            //Gate EQ 
            15 01 00 00 00 00 02 36 73
            //VGLO pull GND
            15 01 00 00 00 00 02 37 02
			15 01 00 00 00 00 02 4c 01
			15 01 00 00 00 00 02 6f 00
            15 01 00 00 00 00 02 71 2C
			15 01 00 00 00 00 02 ff 00
			15 01 00 00 00 00 02 fb 01
			//gamma begin
			//Page Select CMD2,Page0 
            15 01 00 00 00 00 02 FF 01
            //Don't reload MTP 
            15 01 00 00 00 00 02 FB 01
            //Gamma R+ 
            15 01 00 00 00 00 02 75 00
            15 01 00 00 00 00 02 76 5F
            15 01 00 00 00 00 02 77 00
            15 01 00 00 00 00 02 78 97
            15 01 00 00 00 00 02 79 00
            15 01 00 00 00 00 02 7A A1
            15 01 00 00 00 00 02 7B 00
            15 01 00 00 00 00 02 7C B8
            15 01 00 00 00 00 02 7D 00
            15 01 00 00 00 00 02 7E CC
            15 01 00 00 00 00 02 7F 00
            15 01 00 00 00 00 02 80 E2
            15 01 00 00 00 00 02 81 00
            15 01 00 00 00 00 02 82 EC
            15 01 00 00 00 00 02 83 00
            15 01 00 00 00 00 02 84 F9
            15 01 00 00 00 00 02 85 01
            15 01 00 00 00 00 02 86 08
            15 01 00 00 00 00 02 87 01
            15 01 00 00 00 00 02 88 2F
            15 01 00 00 00 00 02 89 01
            15 01 00 00 00 00 02 8A 50
            15 01 00 00 00 00 02 8B 01
            15 01 00 00 00 00 02 8C 8E
            15 01 00 00 00 00 02 8D 01
            15 01 00 00 00 00 02 8E B6
            15 01 00 00 00 00 02 8F 01
            15 01 00 00 00 00 02 90 FD
            15 01 00 00 00 00 02 91 02
            15 01 00 00 00 00 02 92 2E
            15 01 00 00 00 00 02 93 02
            15 01 00 00 00 00 02 94 2E
            15 01 00 00 00 00 02 95 02
            15 01 00 00 00 00 02 96 5E
            15 01 00 00 00 00 02 97 02
            15 01 00 00 00 00 02 98 94
            15 01 00 00 00 00 02 99 02
            15 01 00 00 00 00 02 9A B4
            15 01 00 00 00 00 02 9B 02
            15 01 00 00 00 00 02 9C DB
            15 01 00 00 00 00 02 9D 02
            15 01 00 00 00 00 02 9E FD
            15 01 00 00 00 00 02 9F 03
            15 01 00 00 00 00 02 A0 24
            05 01 00 00 00 00 01 A1
            15 01 00 00 00 00 02 A2 03
            15 01 00 00 00 00 02 A3 30
            15 01 00 00 00 00 02 A4 03
            15 01 00 00 00 00 02 A5 3C
            15 01 00 00 00 00 02 A6 03
            15 01 00 00 00 00 02 A7 5B
            05 01 00 00 00 00 01 A8
            15 01 00 00 00 00 02 A9 03
            15 01 00 00 00 00 02 AA 80
            15 01 00 00 00 00 02 AB 03
            15 01 00 00 00 00 02 AC A3
            15 01 00 00 00 00 02 AD 03
            15 01 00 00 00 00 02 AE B1
            15 01 00 00 00 00 02 AF 03
            15 01 00 00 00 00 02 B0 BE
            15 01 00 00 00 00 02 B1 03
            15 01 00 00 00 00 02 B2 BD
            //Gamma R- 
            15 01 00 00 00 00 02 B3 00
            15 01 00 00 00 00 02 B4 D9
            15 01 00 00 00 00 02 B5 01
            15 01 00 00 00 00 02 B6 0D
            15 01 00 00 00 00 02 B7 01
            15 01 00 00 00 00 02 B8 13
            15 01 00 00 00 00 02 B9 01
            15 01 00 00 00 00 02 BA 26
            15 01 00 00 00 00 02 BB 01
            15 01 00 00 00 00 02 BC 3A
            15 01 00 00 00 00 02 BD 01
            15 01 00 00 00 00 02 BE 4F
            15 01 00 00 00 00 02 BF 01
            15 01 00 00 00 00 02 C0 5A
            15 01 00 00 00 00 02 C1 01
            15 01 00 00 00 00 02 C2 66
            15 01 00 00 00 00 02 C3 01
            15 01 00 00 00 00 02 C4 6B
            15 01 00 00 00 00 02 C5 01
            15 01 00 00 00 00 02 C6 97
            15 01 00 00 00 00 02 C7 01
            15 01 00 00 00 00 02 C8 B1
            15 01 00 00 00 00 02 C9 01
            15 01 00 00 00 00 02 CA E8
            15 01 00 00 00 00 02 CB 02
            15 01 00 00 00 00 02 CC 0C
            15 01 00 00 00 00 02 CD 02
            15 01 00 00 00 00 02 CE 48
            15 01 00 00 00 00 02 CF 02
            15 01 00 00 00 00 02 D0 7E
            15 01 00 00 00 00 02 D1 02
            15 01 00 00 00 00 02 D2 7E
            15 01 00 00 00 00 02 D3 02
            15 01 00 00 00 00 02 D4 AE
            15 01 00 00 00 00 02 D5 02
            15 01 00 00 00 00 02 D6 E4
            15 01 00 00 00 00 02 D7 03
            15 01 00 00 00 00 02 D8 03
            15 01 00 00 00 00 02 D9 03
            15 01 00 00 00 00 02 DA 33
            15 01 00 00 00 00 02 DB 03
            15 01 00 00 00 00 02 DC 57
            15 01 00 00 00 00 02 DD 03
            15 01 00 00 00 00 02 DE 83
            15 01 00 00 00 00 02 DF 03
            15 01 00 00 00 00 02 E0 8D
            15 01 00 00 00 00 02 E1 03
            15 01 00 00 00 00 02 E2 99
            15 01 00 00 00 00 02 E3 03
            15 01 00 00 00 00 02 E4 B7
            15 01 00 00 00 00 02 E5 03
            15 01 00 00 00 00 02 E6 CF
            15 01 00 00 00 00 02 E7 03
            15 01 00 00 00 00 02 E8 D8
            15 01 00 00 00 00 02 E9 03
            15 01 00 00 00 00 02 EA E6
            15 01 00 00 00 00 02 EB 03
            15 01 00 00 00 00 02 EC E8
            15 01 00 00 00 00 02 ED 03
            15 01 00 00 00 00 02 EE EA
            //Gamma G+ 
            15 01 00 00 00 00 02 EF 00
            15 01 00 00 00 00 02 F0 2D
            15 01 00 00 00 00 02 F1 00
            15 01 00 00 00 00 02 F2 71
            15 01 00 00 00 00 02 F3 00
            15 01 00 00 00 00 02 F4 87
            15 01 00 00 00 00 02 F5 00
            15 01 00 00 00 00 02 F6 A1
            15 01 00 00 00 00 02 F7 00
            15 01 00 00 00 00 02 F8 B2
            15 01 00 00 00 00 02 F9 00
            15 01 00 00 00 00 02 FA CB
            15 01 00 00 00 00 02 FB 01
            //Page Select CMD1 
            15 01 00 00 00 00 02 FF 00
            //Don't reload MTP 
            15 01 00 00 00 00 02 FB 01
            //Page Select CMD2,Page1 
            15 01 00 00 00 00 02 FF 02
            //Don't reload MTP 
            15 01 00 00 00 00 02 FB 01
            15 01 00 00 00 00 02 00 00
            15 01 00 00 00 00 02 01 D7
            15 01 00 00 00 00 02 02 00
            15 01 00 00 00 00 02 03 E6
            15 01 00 00 00 00 02 04 00
            15 01 00 00 00 00 02 05 F9
            15 01 00 00 00 00 02 06 01
            15 01 00 00 00 00 02 07 2C
            15 01 00 00 00 00 02 08 01
            15 01 00 00 00 00 02 09 4F
            15 01 00 00 00 00 02 0A 01
            15 01 00 00 00 00 02 0B 86
            15 01 00 00 00 00 02 0C 01
            15 01 00 00 00 00 02 0D B3
            15 01 00 00 00 00 02 0E 01
            15 01 00 00 00 00 02 0F FC
            15 01 00 00 00 00 02 10 02
            15 01 00 00 00 00 02 11 2E
            15 01 00 00 00 00 02 12 02
            15 01 00 00 00 00 02 13 2E
            15 01 00 00 00 00 02 14 02
            15 01 00 00 00 00 02 15 5D
            15 01 00 00 00 00 02 16 02
            15 01 00 00 00 00 02 17 92
            15 01 00 00 00 00 02 18 02
            15 01 00 00 00 00 02 19 B2
            15 01 00 00 00 00 02 1A 02
            15 01 00 00 00 00 02 1B DC
            15 01 00 00 00 00 02 1C 02
            15 01 00 00 00 00 02 1D FF
            15 01 00 00 00 00 02 1E 03
            15 01 00 00 00 00 02 1F 27
            15 01 00 00 00 00 02 20 03
            15 01 00 00 00 00 02 21 3B
            15 01 00 00 00 00 02 22 03
            15 01 00 00 00 00 02 23 45
            15 01 00 00 00 00 02 24 03
            15 01 00 00 00 00 02 25 63
            15 01 00 00 00 00 02 26 03
            15 01 00 00 00 00 02 27 77
            15 01 00 00 00 00 02 28 03
            15 01 00 00 00 00 02 29 95
            15 01 00 00 00 00 02 2A 03
            15 01 00 00 00 00 02 2B 9E
            05 01 00 00 00 00 01 2C
            15 01 00 00 00 00 02 2D 03
            05 01 00 00 00 00 01 2E
            15 01 00 00 00 00 02 2F A4
            15 01 00 00 00 00 02 30 03
            15 01 00 00 00 00 02 31 BC
            //Gamma G- 
            15 01 00 00 00 00 02 32 00
            15 01 00 00 00 00 02 33 B2
            15 01 00 00 00 00 02 34 00
            15 01 00 00 00 00 02 35 F1
            15 01 00 00 00 00 02 36 00
            15 01 00 00 00 00 02 37 FC
            15 01 00 00 00 00 02 38 01
            15 01 00 00 00 00 02 39 13
            15 01 00 00 00 00 02 3A 01
            15 01 00 00 00 00 02 3B 21
            05 01 00 00 00 00 01 3C
            15 01 00 00 00 00 02 3D 01
            05 01 00 00 00 00 01 3E
            15 01 00 00 00 00 02 3F 37
            15 01 00 00 00 00 02 40 01
            15 01 00 00 00 00 02 41 44
            15 01 00 00 00 00 02 42 01
            15 01 00 00 00 00 02 43 51
            15 01 00 00 00 00 02 44 01
            15 01 00 00 00 00 02 45 65
            15 01 00 00 00 00 02 46 01
            15 01 00 00 00 00 02 47 8A
            15 01 00 00 00 00 02 48 01
            15 01 00 00 00 00 02 49 A8
            15 01 00 00 00 00 02 4A 01
            15 01 00 00 00 00 02 4B E2
            15 01 00 00 00 00 02 4C 02
            15 01 00 00 00 00 02 4D 0B
            15 01 00 00 00 00 02 4E 02
            15 01 00 00 00 00 02 4F 48
            15 01 00 00 00 00 02 50 02
            15 01 00 00 00 00 02 51 7E
            15 01 00 00 00 00 02 52 02
            15 01 00 00 00 00 02 53 7E
            15 01 00 00 00 00 02 54 02
            15 01 00 00 00 00 02 55 AD
            15 01 00 00 00 00 02 56 02
            05 01 00 00 00 00 01 57
            15 01 00 00 00 00 02 58 E4
            15 01 00 00 00 00 02 59 03
            15 01 00 00 00 00 02 5A 06
            15 01 00 00 00 00 02 5B 03
            15 01 00 00 00 00 02 5C 35
            15 01 00 00 00 00 02 5D 03
            15 01 00 00 00 00 02 5E 59
            15 01 00 00 00 00 02 5F 03
            15 01 00 00 00 00 02 60 80
            15 01 00 00 00 00 02 61 03
            15 01 00 00 00 00 02 62 93
            15 01 00 00 00 00 02 63 03
            15 01 00 00 00 00 02 64 A1
            15 01 00 00 00 00 02 65 03
            15 01 00 00 00 00 02 66 C0
            15 01 00 00 00 00 02 67 03
            15 01 00 00 00 00 02 68 D4
            15 01 00 00 00 00 02 69 03
            15 01 00 00 00 00 02 6A DD
            15 01 00 00 00 00 02 6B 03
            15 01 00 00 00 00 02 6C E3
            15 01 00 00 00 00 02 6D 03
            15 01 00 00 00 00 02 6E E7
            15 01 00 00 00 00 02 6F 03
            15 01 00 00 00 00 02 70 EA
            //Gamma B+ 
            15 01 00 00 00 00 02 71 00
            15 01 00 00 00 00 02 72 5F
            15 01 00 00 00 00 02 73 00
            15 01 00 00 00 00 02 74 97
            15 01 00 00 00 00 02 75 00
            15 01 00 00 00 00 02 76 A1
            15 01 00 00 00 00 02 77 00
            15 01 00 00 00 00 02 78 B6
            15 01 00 00 00 00 02 79 00
            15 01 00 00 00 00 02 7A C6
            15 01 00 00 00 00 02 7B 00
            15 01 00 00 00 00 02 7C D9
            15 01 00 00 00 00 02 7D 00
            15 01 00 00 00 00 02 7E E2
            15 01 00 00 00 00 02 7F 00
            15 01 00 00 00 00 02 80 F1
            15 01 00 00 00 00 02 81 00
            15 01 00 00 00 00 02 82 FD
            15 01 00 00 00 00 02 83 01
            15 01 00 00 00 00 02 84 26
            15 01 00 00 00 00 02 85 01
            15 01 00 00 00 00 02 86 45
            15 01 00 00 00 00 02 87 01
            15 01 00 00 00 00 02 88 83
            15 01 00 00 00 00 02 89 01
            15 01 00 00 00 00 02 8A AF
            15 01 00 00 00 00 02 8B 01
            15 01 00 00 00 00 02 8C F7
            15 01 00 00 00 00 02 8D 02
            15 01 00 00 00 00 02 8E 21
            15 01 00 00 00 00 02 8F 02
            15 01 00 00 00 00 02 90 21
            15 01 00 00 00 00 02 91 02
            15 01 00 00 00 00 02 92 5A
            15 01 00 00 00 00 02 93 02
            15 01 00 00 00 00 02 94 90
            15 01 00 00 00 00 02 95 02
            15 01 00 00 00 00 02 96 B1
            15 01 00 00 00 00 02 97 02
            15 01 00 00 00 00 02 98 DB
            15 01 00 00 00 00 02 99 02
            15 01 00 00 00 00 02 9A F7
            15 01 00 00 00 00 02 9B 03
            15 01 00 00 00 00 02 9C 1E
            15 01 00 00 00 00 02 9D 03
            15 01 00 00 00 00 02 9E 29
            15 01 00 00 00 00 02 9F 03
            15 01 00 00 00 00 02 A0 37
            05 01 00 00 00 00 01 A1
            15 01 00 00 00 00 02 A2 03
            15 01 00 00 00 00 02 A3 56
            15 01 00 00 00 00 02 A4 03
            15 01 00 00 00 00 02 A5 79
            15 01 00 00 00 00 02 A6 03
            15 01 00 00 00 00 02 A7 99
            05 01 00 00 00 00 01 A8
            15 01 00 00 00 00 02 A9 03
            15 01 00 00 00 00 02 AA A7
            15 01 00 00 00 00 02 AB 03
            15 01 00 00 00 00 02 AC B9
            15 01 00 00 00 00 02 AD 03
            15 01 00 00 00 00 02 AE BD
            //Gamma B- 
            15 01 00 00 00 00 02 AF 00
            15 01 00 00 00 00 02 B0 D9
            15 01 00 00 00 00 02 B1 01
            15 01 00 00 00 00 02 B2 0C
            15 01 00 00 00 00 02 B3 01
            15 01 00 00 00 00 02 B4 13
            15 01 00 00 00 00 02 B5 01
            15 01 00 00 00 00 02 B6 26
            15 01 00 00 00 00 02 B7 01
            15 01 00 00 00 00 02 B8 33
            15 01 00 00 00 00 02 B9 01
            15 01 00 00 00 00 02 BA 45
            15 01 00 00 00 00 02 BB 01
            15 01 00 00 00 00 02 BC 50
            15 01 00 00 00 00 02 BD 01
            15 01 00 00 00 00 02 BE 5D
            15 01 00 00 00 00 02 BF 01
            15 01 00 00 00 00 02 C0 69
            15 01 00 00 00 00 02 C1 01
            15 01 00 00 00 00 02 C2 8E
            15 01 00 00 00 00 02 C3 01
            15 01 00 00 00 00 02 C4 A8
            15 01 00 00 00 00 02 C5 01
            15 01 00 00 00 00 02 C6 DC
            15 01 00 00 00 00 02 C7 02
            15 01 00 00 00 00 02 C8 04
            15 01 00 00 00 00 02 C9 02
            15 01 00 00 00 00 02 CA 43
            15 01 00 00 00 00 02 CB 02
            15 01 00 00 00 00 02 CC 87
            15 01 00 00 00 00 02 CD 02
            15 01 00 00 00 00 02 CE 87
            15 01 00 00 00 00 02 CF 02
            15 01 00 00 00 00 02 D0 AA
            15 01 00 00 00 00 02 D1 02
            15 01 00 00 00 00 02 D2 E4
            15 01 00 00 00 00 02 D3 03
            15 01 00 00 00 00 02 D4 05
            15 01 00 00 00 00 02 D5 03
            15 01 00 00 00 00 02 D6 2E
            15 01 00 00 00 00 02 D7 03
            15 01 00 00 00 00 02 D8 51
            15 01 00 00 00 00 02 D9 03
            15 01 00 00 00 00 02 DA 76
            15 01 00 00 00 00 02 DB 03
            15 01 00 00 00 00 02 DC 83
            15 01 00 00 00 00 02 DD 03
            15 01 00 00 00 00 02 DE 8F
            15 01 00 00 00 00 02 DF 03
            15 01 00 00 00 00 02 E0 B2
            15 01 00 00 00 00 02 E1 03
            15 01 00 00 00 00 02 E2 DA
            15 01 00 00 00 00 02 E3 03
            15 01 00 00 00 00 02 E4 E4
            15 01 00 00 00 00 02 E5 03
            15 01 00 00 00 00 02 E6 E6
            15 01 00 00 00 00 02 E7 03
            15 01 00 00 00 00 02 E8 E8
            15 01 00 00 00 00 02 E9 03
            15 01 00 00 00 00 02 EA EA
            //Page select (CMD1) 
            15 01 00 00 00 00 02 FF 00
            15 01 00 00 00 00 02 FB 01
            //gamma end
			15 01 00 00 00 00 02 ff 04
			15 01 00 00 00 00 02 fb 01
			15 01 00 00 00 00 02 ff 00
			15 01 00 00 00 00 02 fb 01
            //CMD2 Page 4 -Display Register
            15 01 00 00 00 00 02 FF 05
            15 01 00 00 00 00 02 FB 01
            15 01 00 00 00 00 02 01 00
            15 01 00 00 00 00 02 02 7F
            15 01 00 00 00 00 02 03 7F
            15 01 00 00 00 00 02 04 7F
            15 01 00 00 00 00 02 05 00
            15 01 00 00 00 00 02 06 00
            15 01 00 00 00 00 02 07 00
            15 01 00 00 00 00 02 08 00
            15 01 00 00 00 00 02 09 02
            15 01 00 00 00 00 02 0A 01
            15 01 00 00 00 00 02 0B 75
            15 01 00 00 00 00 02 0D 0E
            15 01 00 00 00 00 02 0E 1A
            15 01 00 00 00 00 02 0F 09
            15 01 00 00 00 00 02 10 80
            15 01 00 00 00 00 02 14 04
            15 01 00 00 00 00 02 16 08
            15 01 00 00 00 00 02 17 00
            15 01 00 00 00 00 02 19 1F
            15 01 00 00 00 00 02 1A 00
            15 01 00 00 00 00 02 1B FC
            15 01 00 00 00 00 02 1C 00
            15 01 00 00 00 00 02 1D 00
            15 01 00 00 00 00 02 1E 00
            15 01 00 00 00 00 02 1F 80
            15 01 00 00 00 00 02 21 00
            15 01 00 00 00 00 02 24 45
            15 01 00 00 00 00 02 27 05
            15 01 00 00 00 00 02 28 00
            15 01 00 00 00 00 02 29 52
            15 01 00 00 00 00 02 2A A9
            15 01 00 00 00 00 02 2D 02
            15 01 00 00 00 00 02 2F 00
            15 01 00 00 00 00 02 30 30
            15 01 00 00 00 00 02 35 16
            15 01 00 00 00 00 02 36 01
            15 01 00 00 00 00 02 37 00
            15 01 00 00 00 00 02 38 02
            15 01 00 00 00 00 02 39 01
            15 01 00 00 00 00 02 3F 00
            15 01 00 00 00 00 02 40 00
            15 01 00 00 00 00 02 41 00
            15 01 00 00 00 00 02 42 00
            15 01 00 00 00 00 02 4A 01
            15 01 00 00 00 00 02 6F 25
            15 01 00 00 00 00 02 7E E9
            15 01 00 00 00 00 02 82 18
            15 01 00 00 00 00 02 89 C1
            15 01 00 00 00 00 02 A4 05
            15 01 00 00 00 00 02 BB 06
            15 01 00 00 00 00 02 BC 02
            15 01 00 00 00 00 02 FF 00
            15 01 00 00 00 00 02 FB 01
            //CMD2 Page 3 Fre(PWM)=57.292KHz
            15 01 00 00 00 00 02 FF 04
            15 01 00 00 00 00 02 FB 01
            15 01 00 00 00 00 02 07 40
            15 01 00 00 00 00 02 08 03
            //CMD1
            15 01 00 00 00 00 02 FF 00 
            15 01 00 00 00 00 02 fb 01			
            15 01 00 00 00 00 02 BA 03
            15 01 00 00 00 00 02 55 00
            39 01 00 00 00 00 02 53 24
            39 01 00 00 00 00 02 35 20
            39 01 00 00 96 00 02 11 00
            39 01 00 00 00 00 02 29 00
		];
		qcom,mdss-dsi-off-command = [39 01 00 00 32 00 02 28 00
					39 01 00 00 78 00 02 10 00];
		qcom,mdss-dsi-on-command-state = "dsi_lp_mode";
		qcom,mdss-dsi-off-command-state = "dsi_hs_mode";
		qcom,mdss-dsi-h-sync-pulse = <1>;
		qcom,mdss-dsi-traffic-mode = "burst_mode";
		//qcom,mdss-dsi-lane-map = <0>;
		qcom,mdss-dsi-bllp-eof-power-mode;
		qcom,mdss-dsi-bllp-power-mode;
		qcom,mdss-dsi-lane-0-state;
		qcom,mdss-dsi-lane-1-state;
		qcom,mdss-dsi-lane-2-state;
		qcom,mdss-dsi-lane-3-state;
		qcom,mdss-dsi-panel-timings = [32 16 0e 00 38 3a 12 18 10 03 04 00];
		qcom,mdss-dsi-t-clk-post = <0x4>;
		qcom,mdss-dsi-t-clk-pre = <0x11>;
		qcom,mdss-dsi-bl-min-level = <1>;
		qcom,mdss-dsi-bl-max-level = <255>;
		qcom,mdss-dsi-dma-trigger = "trigger_sw";
		qcom,mdss-dsi-mdp-trigger = "none";
		qcom,mdss-dsi-bl-pmic-control-type = "bl_ctrl_dcs";
		qcom,mdss-dsi-reset-sequence = <1 20>, <0 200>, <1 20>;//<1 1500>, <0 30>, <1 23000>;
		qcom,mdss-pan-physical-width-dimension = <59>;
		qcom,mdss-pan-physical-height-dimension = <104>;

	};
};
