/* Copyright (c) 2013, The Linux Foundation. All rights reserved.
 *
 * This program is free software; you can redistribute it and/or modify
 * it under the terms of the GNU General Public License version 2 and
 * only version 2 as published by the Free Software Foundation.
 *
 * This program is distributed in the hope that it will be useful,
 * but WITHOUT ANY WARRANTY; without even the implied warranty of
 * MERCHANTABILITY or FITNESS FOR A PARTICULAR PURPOSE.  See the
 * GNU General Public License for more details.
 */

/*---------------------------------------------------------------------------
 * This file is autogenerated file using gcdb parser. Please do not edit it.
 * Update input XML file to add a new entry or update variable in this file
 * VERSION = "1.0"
 *---------------------------------------------------------------------------*/
&mdss_mdp {
	dsi_lianchuang_nt35592_720_vid: qcom,mdss_dsi_lianchuang_nt35592_720p_video {
		qcom,mdss-dsi-panel-name = "lianchuang nt35592 720p video mode dsi panel";
		qcom,mdss-dsi-panel-controller = <&mdss_dsi0>;
		qcom,mdss-dsi-panel-type = "dsi_video_mode";
		qcom,mdss-dsi-panel-destination = "display_1";
		qcom,mdss-dsi-panel-framerate = <60>;
		qcom,mdss-dsi-virtual-channel-id = <0>;
		qcom,mdss-dsi-stream = <0>;
		qcom,mdss-dsi-panel-width = <720>;
		qcom,mdss-dsi-panel-height = <1280>;
		qcom,mdss-dsi-h-front-porch = <12>;
		qcom,mdss-dsi-h-back-porch = <12>;
		qcom,mdss-dsi-h-pulse-width = <4>;
		qcom,mdss-dsi-h-sync-skew = <0>;
		qcom,mdss-dsi-v-back-porch = <2>;
		qcom,mdss-dsi-v-front-porch = <6>;
		qcom,mdss-dsi-v-pulse-width = <2>;
		qcom,mdss-dsi-h-left-border = <0>;
		qcom,mdss-dsi-h-right-border = <0>;
		qcom,mdss-dsi-v-top-border = <0>;
		qcom,mdss-dsi-v-bottom-border = <0>;
		qcom,mdss-dsi-bpp = <24>;
		qcom,mdss-dsi-color-order = <0>;
		qcom,mdss-dsi-underflow-color = <0xff>;
		qcom,mdss-dsi-border-color = <0>;
		//+++duguowei
		//qcom,mdss-dsi-lane-map = "lane_map_2103";//6<2 1 0 3>
		//---duguowei
		qcom,mdss-dsi-on-command = [
            //CMD2 Page0 -Power 
            15 01 00 00 00 00 02 FF 01
            15 01 00 00 00 00 02 FB 01
            15 01 00 00 00 00 02 00 4A
            15 01 00 00 00 00 02 01 33
            15 01 00 00 00 00 02 02 53
            15 01 00 00 00 00 02 03 55
            15 01 00 00 00 00 02 04 55
            15 01 00 00 00 00 02 05 33
            15 01 00 00 00 00 02 06 22
            15 01 00 00 00 00 02 08 56
            15 01 00 00 00 00 02 09 8f
            15 01 00 00 00 00 02 0B CF
            15 01 00 00 00 00 02 0C CF
            15 01 00 00 00 00 02 0D 2F
            15 01 00 00 00 00 02 0E 29
            15 01 00 00 00 00 02 36 73
            15 01 00 00 00 00 02 0f 0a
            //power mode 
            15 01 00 00 00 00 02 ff ee
            15 01 00 00 00 00 02 fb 01
            15 01 00 00 00 00 02 2b 10
            //gamma2.2
            //page selection cmd start
            15 01 00 00 00 00 02 FF 01
            15 01 00 00 00 00 02 FB 01
            //page selection cmd end
            //R(+) MCR cmd
            15 01 00 00 00 00 02 75 00
            15 01 00 00 00 00 02 76 21
            15 01 00 00 00 00 02 77 00
            15 01 00 00 00 00 02 78 6B
            15 01 00 00 00 00 02 79 00
            15 01 00 00 00 00 02 7A A1
            15 01 00 00 00 00 02 7B 00
            15 01 00 00 00 00 02 7C C2
            15 01 00 00 00 00 02 7D 00
            15 01 00 00 00 00 02 7E DC
            15 01 00 00 00 00 02 7F 00
            15 01 00 00 00 00 02 80 F1
            15 01 00 00 00 00 02 81 01
            15 01 00 00 00 00 02 82 04
            15 01 00 00 00 00 02 83 01
            15 01 00 00 00 00 02 84 14
            15 01 00 00 00 00 02 85 01
            15 01 00 00 00 00 02 86 23
            15 01 00 00 00 00 02 87 01
            15 01 00 00 00 00 02 88 53
            15 01 00 00 00 00 02 89 01
            15 01 00 00 00 00 02 8A 78
            15 01 00 00 00 00 02 8B 01
            15 01 00 00 00 00 02 8C B1
            15 01 00 00 00 00 02 8D 01
            15 01 00 00 00 00 02 8E DC
            15 01 00 00 00 00 02 8F 02
            15 01 00 00 00 00 02 90 1E
            15 01 00 00 00 00 02 91 02
            15 01 00 00 00 00 02 92 52
            15 01 00 00 00 00 02 93 02
            15 01 00 00 00 00 02 94 54
            15 01 00 00 00 00 02 95 02
            15 01 00 00 00 00 02 96 81
            15 01 00 00 00 00 02 97 02
            15 01 00 00 00 00 02 98 B2
            15 01 00 00 00 00 02 99 02
            15 01 00 00 00 00 02 9A D1
            15 01 00 00 00 00 02 9B 02
            15 01 00 00 00 00 02 9C FB
            15 01 00 00 00 00 02 9D 03
            15 01 00 00 00 00 02 9E 19
            15 01 00 00 00 00 02 9F 03
            15 01 00 00 00 00 02 A0 40
            15 01 00 00 00 00 02 A2 03
            15 01 00 00 00 00 02 A3 4D
            15 01 00 00 00 00 02 A4 03
            15 01 00 00 00 00 02 A5 5B
            15 01 00 00 00 00 02 A6 03
            15 01 00 00 00 00 02 A7 6A
            15 01 00 00 00 00 02 A9 03
            15 01 00 00 00 00 02 AA 7C
            15 01 00 00 00 00 02 AB 03
            15 01 00 00 00 00 02 AC 90
            15 01 00 00 00 00 02 AD 03
            15 01 00 00 00 00 02 AE AA
            15 01 00 00 00 00 02 AF 03
            15 01 00 00 00 00 02 B0 D2
            15 01 00 00 00 00 02 B1 03
            15 01 00 00 00 00 02 B2 FF
            //R(-) MCR cmd
            15 01 00 00 00 00 02 B3 00
            15 01 00 00 00 00 02 B4 21
            15 01 00 00 00 00 02 B5 00
            15 01 00 00 00 00 02 B6 6B
            15 01 00 00 00 00 02 B7 00
            15 01 00 00 00 00 02 B8 A1
            15 01 00 00 00 00 02 B9 00
            15 01 00 00 00 00 02 BA C2
            15 01 00 00 00 00 02 BB 00
            15 01 00 00 00 00 02 BC DC
            15 01 00 00 00 00 02 BD 00
            15 01 00 00 00 00 02 BE F1
            15 01 00 00 00 00 02 BF 01
            15 01 00 00 00 00 02 C0 04
            15 01 00 00 00 00 02 C1 01
            15 01 00 00 00 00 02 C2 14
            15 01 00 00 00 00 02 C3 01
            15 01 00 00 00 00 02 C4 23
            15 01 00 00 00 00 02 C5 01
            15 01 00 00 00 00 02 C6 53
            15 01 00 00 00 00 02 C7 01
            15 01 00 00 00 00 02 C8 78
            15 01 00 00 00 00 02 C9 01
            15 01 00 00 00 00 02 CA B1
            15 01 00 00 00 00 02 CB 01
            15 01 00 00 00 00 02 CC DC
            15 01 00 00 00 00 02 CD 02
            15 01 00 00 00 00 02 CE 1E
            15 01 00 00 00 00 02 CF 02
            15 01 00 00 00 00 02 D0 52
            15 01 00 00 00 00 02 D1 02
            15 01 00 00 00 00 02 D2 54
            15 01 00 00 00 00 02 D3 02
            15 01 00 00 00 00 02 D4 81
            15 01 00 00 00 00 02 D5 02
            15 01 00 00 00 00 02 D6 B2
            15 01 00 00 00 00 02 D7 02
            15 01 00 00 00 00 02 D8 D1
            15 01 00 00 00 00 02 D9 02
            15 01 00 00 00 00 02 DA FB
            15 01 00 00 00 00 02 DB 03
            15 01 00 00 00 00 02 DC 19
            15 01 00 00 00 00 02 DD 03
            15 01 00 00 00 00 02 DE 40
            15 01 00 00 00 00 02 DF 03
            15 01 00 00 00 00 02 E0 4D
            15 01 00 00 00 00 02 E1 03
            15 01 00 00 00 00 02 E2 5B
            15 01 00 00 00 00 02 E3 03
            15 01 00 00 00 00 02 E4 6A
            15 01 00 00 00 00 02 E5 03
            15 01 00 00 00 00 02 E6 7C
            15 01 00 00 00 00 02 E7 03
            15 01 00 00 00 00 02 E8 90
            15 01 00 00 00 00 02 E9 03
            15 01 00 00 00 00 02 EA AA
            15 01 00 00 00 00 02 EB 03
            15 01 00 00 00 00 02 EC D2
            15 01 00 00 00 00 02 ED 03
            15 01 00 00 00 00 02 EE FF
            //G(+) MCR cmd
            15 01 00 00 00 00 02 EF 00
            15 01 00 00 00 00 02 F0 21
            15 01 00 00 00 00 02 F1 00
            15 01 00 00 00 00 02 F2 6B
            15 01 00 00 00 00 02 F3 00
            15 01 00 00 00 00 02 F4 A1
            15 01 00 00 00 00 02 F5 00
            15 01 00 00 00 00 02 F6 C2
            15 01 00 00 00 00 02 F7 00
            15 01 00 00 00 00 02 F8 DC
            15 01 00 00 00 00 02 F9 00
            15 01 00 00 00 00 02 FA F1
            //page selection cmd start
            15 01 00 00 00 00 02 FF 02
            15 01 00 00 00 00 02 FB 01
            //page selection cmd end
            15 01 00 00 00 00 02 00 01
            15 01 00 00 00 00 02 01 04
            15 01 00 00 00 00 02 02 01
            15 01 00 00 00 00 02 03 14
            15 01 00 00 00 00 02 04 01
            15 01 00 00 00 00 02 05 23
            15 01 00 00 00 00 02 06 01
            15 01 00 00 00 00 02 07 53
            15 01 00 00 00 00 02 08 01
            15 01 00 00 00 00 02 09 78
            15 01 00 00 00 00 02 0A 01
            15 01 00 00 00 00 02 0B B1
            15 01 00 00 00 00 02 0C 01
            15 01 00 00 00 00 02 0D DC
            15 01 00 00 00 00 02 0E 02
            15 01 00 00 00 00 02 0F 1E
            15 01 00 00 00 00 02 10 02
            15 01 00 00 00 00 02 11 52
            15 01 00 00 00 00 02 12 02
            15 01 00 00 00 00 02 13 54
            15 01 00 00 00 00 02 14 02
            15 01 00 00 00 00 02 15 81
            15 01 00 00 00 00 02 16 02
            15 01 00 00 00 00 02 17 B2
            15 01 00 00 00 00 02 18 02
            15 01 00 00 00 00 02 19 D1
            15 01 00 00 00 00 02 1A 02
            15 01 00 00 00 00 02 1B FB
            15 01 00 00 00 00 02 1C 03
            15 01 00 00 00 00 02 1D 19
            15 01 00 00 00 00 02 1E 03
            15 01 00 00 00 00 02 1F 40
            15 01 00 00 00 00 02 20 03
            15 01 00 00 00 00 02 21 4D
            15 01 00 00 00 00 02 22 03
            15 01 00 00 00 00 02 23 5B
            15 01 00 00 00 00 02 24 03
            15 01 00 00 00 00 02 25 6A
            15 01 00 00 00 00 02 26 03
            15 01 00 00 00 00 02 27 7C
            15 01 00 00 00 00 02 28 03
            15 01 00 00 00 00 02 29 90
            15 01 00 00 00 00 02 2A 03
            15 01 00 00 00 00 02 2B AA
            15 01 00 00 00 00 02 2D 03
            15 01 00 00 00 00 02 2F D2
            15 01 00 00 00 00 02 30 03
            15 01 00 00 00 00 02 31 FF
            //G(-) MCR cmd
            15 01 00 00 00 00 02 32 00
            15 01 00 00 00 00 02 33 21
            15 01 00 00 00 00 02 34 00
            15 01 00 00 00 00 02 35 6B
            15 01 00 00 00 00 02 36 00
            15 01 00 00 00 00 02 37 A1
            15 01 00 00 00 00 02 38 00
            15 01 00 00 00 00 02 39 C2
            15 01 00 00 00 00 02 3A 00
            15 01 00 00 00 00 02 3B DC
            15 01 00 00 00 00 02 3D 00
            15 01 00 00 00 00 02 3F F1
            15 01 00 00 00 00 02 40 01
            15 01 00 00 00 00 02 41 04
            15 01 00 00 00 00 02 42 01
            15 01 00 00 00 00 02 43 14
            15 01 00 00 00 00 02 44 01
            15 01 00 00 00 00 02 45 23
            15 01 00 00 00 00 02 46 01
            15 01 00 00 00 00 02 47 53
            15 01 00 00 00 00 02 48 01
            15 01 00 00 00 00 02 49 78
            15 01 00 00 00 00 02 4A 01
            15 01 00 00 00 00 02 4B B1
            15 01 00 00 00 00 02 4C 01
            15 01 00 00 00 00 02 4D DC
            15 01 00 00 00 00 02 4E 02
            15 01 00 00 00 00 02 4F 1E
            15 01 00 00 00 00 02 50 02
            15 01 00 00 00 00 02 51 52
            15 01 00 00 00 00 02 52 02
            15 01 00 00 00 00 02 53 54
            15 01 00 00 00 00 02 54 02
            15 01 00 00 00 00 02 55 81
            15 01 00 00 00 00 02 56 02
            15 01 00 00 00 00 02 58 B2
            15 01 00 00 00 00 02 59 02
            15 01 00 00 00 00 02 5A D1
            15 01 00 00 00 00 02 5B 02
            15 01 00 00 00 00 02 5C FB
            15 01 00 00 00 00 02 5D 03
            15 01 00 00 00 00 02 5E 19
            15 01 00 00 00 00 02 5F 03
            15 01 00 00 00 00 02 60 40
            15 01 00 00 00 00 02 61 03
            15 01 00 00 00 00 02 62 4D
            15 01 00 00 00 00 02 63 03
            15 01 00 00 00 00 02 64 5B
            15 01 00 00 00 00 02 65 03
            15 01 00 00 00 00 02 66 6A
            15 01 00 00 00 00 02 67 03
            15 01 00 00 00 00 02 68 7C
            15 01 00 00 00 00 02 69 03
            15 01 00 00 00 00 02 6A 90
            15 01 00 00 00 00 02 6B 03
            15 01 00 00 00 00 02 6C AA
            15 01 00 00 00 00 02 6D 03
            15 01 00 00 00 00 02 6E D2
            15 01 00 00 00 00 02 6F 03
            15 01 00 00 00 00 02 70 FF
            //B(+) MCR cmd
            15 01 00 00 00 00 02 71 00
            15 01 00 00 00 00 02 72 21
            15 01 00 00 00 00 02 73 00
            15 01 00 00 00 00 02 74 6B
            15 01 00 00 00 00 02 75 00
            15 01 00 00 00 00 02 76 A1
            15 01 00 00 00 00 02 77 00
            15 01 00 00 00 00 02 78 C2
            15 01 00 00 00 00 02 79 00
            15 01 00 00 00 00 02 7A DC
            15 01 00 00 00 00 02 7B 00
            15 01 00 00 00 00 02 7C F1
            15 01 00 00 00 00 02 7D 01
            15 01 00 00 00 00 02 7E 04
            15 01 00 00 00 00 02 7F 01
            15 01 00 00 00 00 02 80 14
            15 01 00 00 00 00 02 81 01
            15 01 00 00 00 00 02 82 23
            15 01 00 00 00 00 02 83 01
            15 01 00 00 00 00 02 84 53
            15 01 00 00 00 00 02 85 01
            15 01 00 00 00 00 02 86 78
            15 01 00 00 00 00 02 87 01
            15 01 00 00 00 00 02 88 B1
            15 01 00 00 00 00 02 89 01
            15 01 00 00 00 00 02 8A DC
            15 01 00 00 00 00 02 8B 02
            15 01 00 00 00 00 02 8C 1E
            15 01 00 00 00 00 02 8D 02
            15 01 00 00 00 00 02 8E 52
            15 01 00 00 00 00 02 8F 02
            15 01 00 00 00 00 02 90 54
            15 01 00 00 00 00 02 91 02
            15 01 00 00 00 00 02 92 81
            15 01 00 00 00 00 02 93 02
            15 01 00 00 00 00 02 94 B2
            15 01 00 00 00 00 02 95 02
            15 01 00 00 00 00 02 96 D1
            15 01 00 00 00 00 02 97 02
            15 01 00 00 00 00 02 98 FB
            15 01 00 00 00 00 02 99 03
            15 01 00 00 00 00 02 9A 19
            15 01 00 00 00 00 02 9B 03
            15 01 00 00 00 00 02 9C 40
            15 01 00 00 00 00 02 9D 03
            15 01 00 00 00 00 02 9E 4D
            15 01 00 00 00 00 02 9F 03
            15 01 00 00 00 00 02 A0 5B
            15 01 00 00 00 00 02 A2 03
            15 01 00 00 00 00 02 A3 6A
            15 01 00 00 00 00 02 A4 03
            15 01 00 00 00 00 02 A5 7C
            15 01 00 00 00 00 02 A6 03
            15 01 00 00 00 00 02 A7 90
            15 01 00 00 00 00 02 A9 03
            15 01 00 00 00 00 02 AA AA
            15 01 00 00 00 00 02 AB 03
            15 01 00 00 00 00 02 AC D2
            15 01 00 00 00 00 02 AD 03
            15 01 00 00 00 00 02 AE FF
            //B(-) MCR cmd
            15 01 00 00 00 00 02 AF 00
            15 01 00 00 00 00 02 B0 21
            15 01 00 00 00 00 02 B1 00
            15 01 00 00 00 00 02 B2 6B
            15 01 00 00 00 00 02 B3 00
            15 01 00 00 00 00 02 B4 A1
            15 01 00 00 00 00 02 B5 00
            15 01 00 00 00 00 02 B6 C2
            15 01 00 00 00 00 02 B7 00
            15 01 00 00 00 00 02 B8 DC
            15 01 00 00 00 00 02 B9 00
            15 01 00 00 00 00 02 BA F1
            15 01 00 00 00 00 02 BB 01
            15 01 00 00 00 00 02 BC 04
            15 01 00 00 00 00 02 BD 01
            15 01 00 00 00 00 02 BE 14
            15 01 00 00 00 00 02 BF 01
            15 01 00 00 00 00 02 C0 23
            15 01 00 00 00 00 02 C1 01
            15 01 00 00 00 00 02 C2 53
            15 01 00 00 00 00 02 C3 01
            15 01 00 00 00 00 02 C4 78
            15 01 00 00 00 00 02 C5 01
            15 01 00 00 00 00 02 C6 B1
            15 01 00 00 00 00 02 C7 01
            15 01 00 00 00 00 02 C8 DC
            15 01 00 00 00 00 02 C9 02
            15 01 00 00 00 00 02 CA 1E
            15 01 00 00 00 00 02 CB 02
            15 01 00 00 00 00 02 CC 52
            15 01 00 00 00 00 02 CD 02
            15 01 00 00 00 00 02 CE 54
            15 01 00 00 00 00 02 CF 02
            15 01 00 00 00 00 02 D0 81
            15 01 00 00 00 00 02 D1 02
            15 01 00 00 00 00 02 D2 B2
            15 01 00 00 00 00 02 D3 02
            15 01 00 00 00 00 02 D4 D1
            15 01 00 00 00 00 02 D5 02
            15 01 00 00 00 00 02 D6 FB
            15 01 00 00 00 00 02 D7 03
            15 01 00 00 00 00 02 D8 19
            15 01 00 00 00 00 02 D9 03
            15 01 00 00 00 00 02 DA 40
            15 01 00 00 00 00 02 DB 03
            15 01 00 00 00 00 02 DC 4D
            15 01 00 00 00 00 02 DD 03
            15 01 00 00 00 00 02 DE 5B
            15 01 00 00 00 00 02 DF 03
            15 01 00 00 00 00 02 E0 6A
            15 01 00 00 00 00 02 E1 03
            15 01 00 00 00 00 02 E2 7C
            15 01 00 00 00 00 02 E3 03
            15 01 00 00 00 00 02 E4 90
            15 01 00 00 00 00 02 E5 03
            15 01 00 00 00 00 02 E6 AA
            15 01 00 00 00 00 02 E7 03
            15 01 00 00 00 00 02 E8 D2
            15 01 00 00 00 00 02 E9 03
            15 01 00 00 00 00 02 EA FF
            //gamma 2.2 end
            //CMD2 Page 4 -Display Register
            15 01 00 00 00 00 02 FF 05
            15 01 00 00 00 00 02 FB 01
            15 01 00 00 00 00 02 01 00
            15 01 00 00 00 00 02 02 82
            15 01 00 00 00 00 02 03 82
            15 01 00 00 00 00 02 04 82
            15 01 00 00 00 00 02 06 33
            15 01 00 00 00 00 02 07 01
            15 01 00 00 00 00 02 08 00
            15 01 00 00 00 00 02 09 46
            15 01 00 00 00 00 02 0A 46
            15 01 00 00 00 00 02 0D 0B
            15 01 00 00 00 00 02 0E 1D
            15 01 00 00 00 00 02 0F 08
            15 01 00 00 00 00 02 10 53
            15 01 00 00 00 00 02 11 00
            15 01 00 00 00 00 02 12 00
            15 01 00 00 00 00 02 14 01
            15 01 00 00 00 00 02 15 00
            15 01 00 00 00 00 02 16 05
            15 01 00 00 00 00 02 17 00
            15 01 00 00 00 00 02 19 7F
            15 01 00 00 00 00 02 1A FF
            15 01 00 00 00 00 02 1B 0F
            15 01 00 00 00 00 02 1C 00
            15 01 00 00 00 00 02 1D 00
            15 01 00 00 00 00 02 1E 00
            15 01 00 00 00 00 02 1F 07
            15 01 00 00 00 00 02 20 00
            15 01 00 00 00 00 02 21 00
            15 01 00 00 00 00 02 22 55
            15 01 00 00 00 00 02 23 4d
            15 01 00 00 00 00 02 2D 02
            15 01 00 00 00 00 02 83 01
            15 01 00 00 00 00 02 9e 58
            15 01 00 00 00 00 02 9f 68
            15 01 00 00 00 00 02 a0 01
            15 01 00 00 00 00 02 a2 10
            15 01 00 00 00 00 02 bb 0a
            15 01 00 00 00 00 02 bc 0a
            15 01 00 00 00 00 02 28 01
            15 01 00 00 00 00 02 2f 02
            15 01 00 00 00 00 02 32 08
            15 01 00 00 00 00 02 33 b8
            15 01 00 00 00 00 02 36 01
            15 01 00 00 00 00 02 37 00
            15 01 00 00 00 00 02 43 00
            15 01 00 00 00 00 02 4b 21
            15 01 00 00 00 00 02 4c 03
            15 01 00 00 00 00 02 50 21
            15 01 00 00 00 00 02 51 03
            15 01 00 00 00 00 02 58 21
            15 01 00 00 00 00 02 59 03
            15 01 00 00 00 00 02 5d 21
            15 01 00 00 00 00 02 5e 03
            15 01 00 00 00 00 02 6c 00
            15 01 00 00 00 00 02 6d 00
            //non-reload MTP
            //CMD1
            15 01 00 00 00 00 02 FF 00 
            15 01 00 00 00 00 02 fb 01
            //CMD2, Page0
            15 01 00 00 00 00 02 FF 01 
            15 01 00 00 00 00 02 fb 01
            //CMD2, Page1
            15 01 00 00 00 00 02 FF 02 
            15 01 00 00 00 00 02 fb 01
            //CMD2, Page2
            15 01 00 00 00 00 02 FF 03
            15 01 00 00 00 00 02 fb 01
            //CMD2, Page3
            15 01 00 00 00 00 02 FF 04
            15 01 00 00 00 00 02 FB 01
            //CMD2, Page4
            15 01 00 00 00 00 02 FF 05
            15 01 00 00 00 00 02 fb 01
            //CMD2, Page3 Fre(PWM)=57.292KHz
            15 01 00 00 00 00 02 FF 04
            15 01 00 00 00 00 02 FB 01
            15 01 00 00 00 00 02 07 40
            15 01 00 00 00 00 02 08 03
            //CMD1
            15 01 00 00 00 00 02 FF 00 
            15 01 00 00 00 00 02 fb 01			
            15 01 00 00 00 00 02 BA 03
            39 01 00 00 00 00 02 35 00
            39 01 00 00 78 00 02 11 00
            15 01 00 00 00 00 02 55 00
            39 01 00 00 00 00 02 53 24
            39 01 00 00 00 00 02 29 00      
		];
		qcom,mdss-dsi-off-command = [39 01 00 00 32 00 02 28 00
					39 01 00 00 78 00 02 10 00];
		qcom,mdss-dsi-on-command-state = "dsi_lp_mode";
		qcom,mdss-dsi-off-command-state = "dsi_hs_mode";
		qcom,mdss-dsi-h-sync-pulse = <1>;
		qcom,mdss-dsi-traffic-mode = "burst_mode";
		//qcom,mdss-dsi-lane-map = <0>;
		qcom,mdss-dsi-bllp-eof-power-mode;
		qcom,mdss-dsi-bllp-power-mode;
		qcom,mdss-dsi-lane-0-state;
		qcom,mdss-dsi-lane-1-state;
		qcom,mdss-dsi-lane-2-state;
		qcom,mdss-dsi-lane-3-state;
		// dsi panel timings from lianchuang(mass production)
        qcom,mdss-dsi-panel-timings = [93 1F 17 00 2f 50 1c 21 26 03 04 00];
		qcom,mdss-dsi-t-clk-post = <0x4>;
		qcom,mdss-dsi-t-clk-pre = <0x12>;
		qcom,mdss-dsi-bl-min-level = <1>;
		qcom,mdss-dsi-bl-max-level = <255>;
		qcom,mdss-dsi-dma-trigger = "trigger_sw";
		qcom,mdss-dsi-mdp-trigger = "none";
		qcom,mdss-dsi-bl-pmic-control-type = "bl_ctrl_dcs";
		qcom,mdss-dsi-reset-sequence = <1 20>, <0 200>, <1 20>;//<1 1500>, <0 1000>, <1 50000>;
		qcom,mdss-pan-physical-width-dimension = <59>;
		qcom,mdss-pan-physical-height-dimension = <104>;
	};
};
