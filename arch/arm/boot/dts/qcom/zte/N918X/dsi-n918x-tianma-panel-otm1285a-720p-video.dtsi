/* Copyright (c) 2013, The Linux Foundation. All rights reserved.
 *
 * This program is free software; you can redistribute it and/or modify
 * it under the terms of the GNU General Public License version 2 and
 * only version 2 as published by the Free Software Foundation.
 *
 * This program is distributed in the hope that it will be useful,
 * but WITHOUT ANY WARRANTY; without even the implied warranty of
 * MERCHANTABILITY or FITNESS FOR A PARTICULAR PURPOSE.  See the
 * GNU General Public License for more details.
 */

/*---------------------------------------------------------------------------
 * This file is autogenerated file using gcdb parser. Please do not edit it.
 * Update input XML file to add a new entry or update variable in this file
 * VERSION = "1.0"
 *---------------------------------------------------------------------------*/
&mdss_mdp {
	dsi_tianma_otm1285a_720_vid: qcom,mdss_dsi_tianma_otm1285a_720p_video {
		qcom,mdss-dsi-panel-name = "tianma otm1285a 720p video mode dsi panel";
		qcom,mdss-dsi-panel-controller = <&mdss_dsi0>;
		qcom,mdss-dsi-panel-type = "dsi_video_mode";
		qcom,mdss-dsi-panel-destination = "display_1";
		qcom,mdss-dsi-panel-framerate = <60>;
		qcom,mdss-dsi-virtual-channel-id = <0>;
		qcom,mdss-dsi-stream = <0>;
		qcom,mdss-dsi-panel-width = <720>;
		qcom,mdss-dsi-panel-height = <1280>;
		qcom,mdss-dsi-h-front-porch = <152>;
		qcom,mdss-dsi-h-back-porch = <152>;
		qcom,mdss-dsi-h-pulse-width = <20>;
		qcom,mdss-dsi-h-sync-skew = <0>;
		qcom,mdss-dsi-v-back-porch = <8>;
		qcom,mdss-dsi-v-front-porch = <8>;
		qcom,mdss-dsi-v-pulse-width = <4>;
		qcom,mdss-dsi-h-left-border = <0>;
		qcom,mdss-dsi-h-right-border = <0>;
		qcom,mdss-dsi-v-top-border = <0>;
		qcom,mdss-dsi-v-bottom-border = <0>;
		qcom,mdss-dsi-bpp = <24>;
		qcom,mdss-dsi-color-order = <0>;
		qcom,mdss-dsi-underflow-color = <0xff>;
		qcom,mdss-dsi-border-color = <0>;
		qcom,mdss-dsi-on-command = [29 01 00 00 00 00 04 FF 12 82 01
					23 01 00 00 00 00 02 00 00
					29 01 00 00 00 00 04 FF 12 85 01
					23 01 00 00 00 00 02 00 80
					29 01 00 00 00 00 03 FF 12 85
					23 01 00 00 00 00 02 00 C0
					29 01 00 00 00 00 10 CB FD FD FD FD FD 00 00 00 00 00 00 00 00 00 00
					23 01 00 00 00 00 02 00 D0
					29 01 00 00 00 00 0d CB 00 00 00 00 FD 00 FD FD FD 00 00 00
					23 01 00 00 00 00 02 00 90
					29 01 00 00 00 00 0f F5 03 15 09 15 07 15 0D 15 0B 15 09 15 0A 25
					23 01 00 00 00 00 02 00 A0
					29 01 00 00 00 00 0f F5 12 11 03 15 09 15 11 15 08 25 07 25 09 25
					23 01 00 00 00 00 02 00 C0
					29 01 00 00 00 00 0f F5 0E 15 0E 15 00 15 00 15 0E 15 14 11 00 25
					23 01 00 00 00 00 02 00 D0
					29 01 00 00 00 00 10 F5 07 15 0A 15 10 11 00 10 90 90 90 0C 90 00 00
					23 01 00 00 00 00 02 00 A3
					39 01 00 00 00 00 02 B6 03
					23 01 00 00 00 00 02 00 A0
					29 01 00 00 00 00 0d D6 00 00 00 00 00 00 00 00 00 00 00 00
					23 01 00 00 00 00 02 00 B0
					29 01 00 00 00 00 0d D6 00 00 5A B3 B3 B3 B3 B3 B3 B3 B3 B3
					23 01 00 00 00 00 02 00 C0
					29 01 00 00 00 00 0d D6 3C 00 77 77 77 77 77 77 77 77 77 77
					23 01 00 00 00 00 02 00 D0
					29 01 00 00 00 00 0d D6 3C 3C 3C 3C 3C 3C 3C 3C 3C 3C 3C 3C
					39 01 00 00 00 00 02 59 00
					29 01 00 00 00 00 02 55 01
					23 01 00 00 00 00 02 00 00
					29 01 00 00 00 00 02 FB 01
					39 01 00 00 00 00 02 53 24
					39 01 00 00 78 00 02 11 00
					39 01 00 00 0a 00 02 29 00];
		qcom,mdss-dsi-off-command = [39 01 00 00 00 00 02 51 00
					39 01 00 00 00 00 02 53 00
					39 01 00 00 05 00 02 22 00
					39 01 00 00 32 00 02 28 00
					39 01 00 00 64 00 02 10 00];
		qcom,mdss-dsi-on-command-state = "dsi_lp_mode";
		qcom,mdss-dsi-off-command-state = "dsi_hs_mode";
		qcom,mdss-dsi-h-sync-pulse = <1>;
		qcom,mdss-dsi-traffic-mode = "burst_mode";
		qcom,mdss-dsi-lane-map = <0>;
		qcom,mdss-dsi-bllp-eof-power-mode;
		qcom,mdss-dsi-bllp-power-mode;
		qcom,mdss-dsi-lane-0-state;
		qcom,mdss-dsi-lane-1-state;
		qcom,mdss-dsi-lane-2-state;
		qcom,mdss-dsi-lane-3-state;
		qcom,mdss-dsi-panel-timings = [8B 1E 14 00 44 48 18 22 19 03 04 00];
		qcom,mdss-dsi-t-clk-post = <0x04>;
		qcom,mdss-dsi-t-clk-pre = <0x1C>;
		qcom,mdss-dsi-bl-min-level = <10>;
		qcom,mdss-dsi-bl-max-level = <255>;
		qcom,mdss-dsi-bright-to-bl-lvl-para-a1 = <95>;
		qcom,mdss-dsi-bright-to-bl-lvl-para-a2 = <99>;
		qcom,mdss-dsi-bright-to-bl-lvl-para-b1 = <421>;
		qcom,mdss-dsi-bright-to-bl-lvl-para-b2 = <370>;
		qcom,mdss-dsi-bright-to-bl-lvl-turn-point = <186>;
		qcom,mdss-dsi-dma-trigger = "trigger_sw";
		qcom,mdss-dsi-mdp-trigger = "none";
		qcom,mdss-dsi-bl-pmic-control-type = "bl_ctrl_dcs";
		qcom,mdss-dsi-reset-sequence = <1 20>, <0 200>, <1 20>;
		qcom,mdss-pan-physical-width-dimension = <59>;
		qcom,mdss-pan-physical-height-dimension = <104>;
	};
};
